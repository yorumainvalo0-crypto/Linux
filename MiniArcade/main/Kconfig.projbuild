## MiniArcade/main/Kconfig.projbuild
```kconfig
menu "MiniArcade"
    config ARCADE_GITHUB_REPO
        string "GitHub repository that publishes the firmware releases"
        default "yorumainvalo0-crypto/Linux"
        help
            owner/name of the repository. The board downloads
            releases/latest/download/version.txt and miniarcade.bin from it.
            The GitHub build sets this to the repository it runs in.
    config ARCADE_WIFI_TX_POWER
        int "WLAN transmit power limit (0.25 dBm steps, 0 = no limit)"
        default 34
        range 0 84
        help
            Many ESP32-C3 SuperMini boards have a poorly matched antenna
            and cannot join a network at full power. 34 = 8.5 dBm works on
            most of them; raise it for more range, 0 keeps the default.
endmenu
```

## MiniArcadeColor/main/Kconfig.projbuild
```kconfig
menu "MiniArcade Color"
    config ARCADE_GITHUB_REPO
        string "GitHub repository that publishes the firmware releases"
        default "yorumainvalo0-crypto/Linux"
        help
            owner/name of the repository. The GitHub build sets this to the
            repository it runs in.
    config ARCADE_UPDATE_PATH
        string "Release path of the updates (own channel, not the OLED console's)"
        default "releases/download/color-latest/"
    config ARCADE_UPDATE_BIN
        string "Firmware file in that release"
        default "miniarcade-color-s3.bin" if IDF_TARGET_ESP32S3
        default "miniarcade-color-c3.bin"
    config ARCADE_WIFI_TX_POWER
        int "WLAN transmit power limit (0.25 dBm steps, 0 = no limit)"
        default 34 if IDF_TARGET_ESP32C3
        default 0
        range 0 84

    menu "Display (ILI9341 / ST7789, SPI)"
        comment "With SDO wired the pins are found at the start; these are the fallback."
        config ARCADE_TFT_SCK
            int "SCK pin"
            default 12 if IDF_TARGET_ESP32S3
            default 8
        config ARCADE_TFT_MOSI
            int "SDI (MOSI) pin"
            default 11 if IDF_TARGET_ESP32S3
            default 9
        config ARCADE_TFT_MISO
            int "SDO (MISO) pin, -1 = not wired"
            default 13 if IDF_TARGET_ESP32S3
            default 20
            help
                Not needed for the picture. Kept for the SD card and touch,
                which share the bus.
        config ARCADE_TFT_CS
            int "CS pin"
            default 10 if IDF_TARGET_ESP32S3
            default 21
        config ARCADE_TFT_DC
            int "DC pin"
            default 9 if IDF_TARGET_ESP32S3
            default 4
        config ARCADE_TFT_RST
            int "RESET pin (-1 = wired to 3V3)"
            default -1 if IDF_TARGET_ESP32S3
            default 5
        config ARCADE_TFT_BL
            int "LED (backlight) pin (-1 = wired to 3V3)"
            default -1
        config ARCADE_TFT_MHZ
            int "SPI clock in MHz"
            default 40
        config ARCADE_TFT_ST7789
            bool "ST7789 controller instead of ILI9341"
            default n
    endmenu

    menu "Gyroscope (MPU6050, I2C - not used yet)"
        config ARCADE_I2C_SDA
            int "SDA pin (-1 = none)"
            default 8 if IDF_TARGET_ESP32S3
            default -1
        config ARCADE_I2C_SCL
            int "SCL pin (-1 = none)"
            default 18 if IDF_TARGET_ESP32S3
            default -1
    endmenu
endmenu
```

## MiniArcadeColor/sdkconfig.defaults.esp32s3
```kconfig
CONFIG_ARCADE_UPDATE_BIN="miniarcade-color-s3.bin"
CONFIG_ESPTOOLPY_FLASHSIZE_4MB=y
```
